/*
 * Device Tree Source for the Ale4 board
 *
 * Copyright (C) 2015-2016 Renesas Electronics Corporation
 *
 * This file is licensed under the terms of the GNU General Public License
 * version 2.  This program is licensed "as is" without any warranty of any
 * kind, whether express or implied.
 */

/dts-v1/;
#include "r8a7794x-alex.dtsi"

/ {
	model = "Ale4";
	compatible = "renesas,ale4", "renesas,r8a77946";
};
